## drivers/usbh/Kconfig
```kconfig
# Copyright (c) 2020 PHYTEC Messtechnik GmbH
# SPDX-License-Identifier: Apache-2.0

if USBH

config USB_HOST_DRIVER
	bool

config USBH_SAM0
	bool "SAM0 series USB Host Controller driver"
	default y
	depends on SOC_FAMILY_SAM0
	select USB_HOST_DRIVER
	help
	  SAM0 family USB host controller Driver.

config USBH_STM32
	bool "STM Series USB Host Controller Driver"
	default n

endif
```

## dts/bindings/usbh/atmel,sam0-usbh.yaml
```yaml
include: usbh.yaml

compatible: "atmel,sam0-usbh"
properties:
        reg: 
                required: true
        
        interrupts:

                required: true

        buf-len:
                type: int
                required: true

        nbr-ep-bulk:
                type: int
                required: true

        nbr-ep-intr:
                type: int
                required: true

        nbr-isoc-ep:
                type: int
                required: true
```

## dts/bindings/usbh/usbh.yaml
```yaml
include: base.yaml

description: USB-Host

properties: 
        label:
                required: true

        status:
                required: false
```

## subsys/usbh/HCD/Kconfig
```kconfig
if USBH

config USB_HOST_DRIVER
	bool

config USBH_SAM0
	bool "SAM0 series USB Host Controller driver"
	default y
	depends on SOC_FAMILY_SAM0
	select USB_HOST_DRIVER
	help
	  SAM0 family USB host controller Driver.

endif
```

## subsys/usbh/Kconfig
```kconfig
# Copyright (c) 2020 PHYTEC Messtechnik GmbH
# SPDX-License-Identifier: Apache-2.0

#temporary should be later in drivers Kconfig
source "subsys/usbh/HCD/Kconfig"

config USBH
	bool "USB Host support"

config UC_USBH_MSC
	bool "USB MSC Class Support"

config UC_USBH_CDC
	bool "USB MSC Class Support"
```
